## conf/machine/agilex.conf
```bitbake
#@TYPE: Machine
#@NAME: Intel Agilex
#@DESCRIPTION: Layer for the Altera Agilex

require conf/machine/include/socfpga_armv8a.inc

KERNEL_DEVICETREE ?= "intel/socfpga_agilex_socdk.dtb"

SERIAL_CONSOLES ?= "115200;ttyS0"

EXTRA_IMAGECMD_jffs2 = "--squash -s 256 -e 64KiB"
```
